## arch/arm/mach-nuvoton/Kconfig
```kconfig
if ARCH_NUVOTON

config SYS_SOC
	default "myir"

config SYS_VENDOR
	default "myir"

config LMA35
        select ARM64
        select DM
        select DM_ETH
        bool "MYD LMA35"
        default n

source "arch/arm/mach-nuvoton/lma35/Kconfig"
source "board/myir/myd-lma35/Kconfig"

config MA35D1
	select ARM64
	select DM
	select DM_ETH
	bool "Nuvoton MA35D1"
	default n

source "arch/arm/mach-nuvoton/ma35d1/Kconfig"
source "board/nuvoton/ma35d1/Kconfig"

config MA35D0
	select ARM64
	select DM
	select DM_ETH
	bool "Nuvoton MA35D0"
	default n

source "arch/arm/mach-nuvoton/ma35d0/Kconfig"
source "board/nuvoton/ma35d0/Kconfig"

config MA35H0
	select ARM64
	select DM
	select DM_ETH
	bool "Nuvoton MA35H0"
	default n

source "arch/arm/mach-nuvoton/ma35h0/Kconfig"
source "board/nuvoton/ma35h0/Kconfig"

endif
```

## arch/arm/mach-nuvoton/lma35/Kconfig
```kconfig
if LMA35

choice
	prompt  "MYIR MYD-LMA35 board select"
	optional

config TARGET_MA35D1_EVB
	bool "MA35D1 EVB"

config TARGET_MA35D1_IOT
	bool "MA35D1 IoT Board"

endchoice

endif
```

## board/myir/myd-lma35/Kconfig
```kconfig
if LMA35

config SYS_BOARD
	default "myd-lma35"

config DDRSIZE_256
	bool "kernelmem 256"

config DDRSIZE_512
	bool "kernelmem 512"

config SYS_VENDOR
	default "myir"

config SYS_CONFIG_NAME
	default "myd-lma35"

endif
```

## drivers/crypto/Kconfig
```kconfig
menu "Hardware crypto devices"

config MA35D1_CRYPTO
	bool "Nuvoton MA35D1 cryptographic accelerator."
	depends on MA35D1
	default y
	help
	  Enables support for the on-chip cryptographic accelerator on MA35D1.

source drivers/crypto/fsl/Kconfig

endmenu
```
